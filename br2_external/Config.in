## br2_external/Config.in
```kconfig
source "$BR2_EXTERNAL_PROJ_EXT_PATH/package/gpioevt/Config.in"
source "$BR2_EXTERNAL_PROJ_EXT_PATH/package/gpioevtd/Config.in"
```

## br2_external/package/gpioevt/Config.in
```kconfig
config BR2_PACKAGE_GPIOEVT
    bool "gpioevt driver"
    help
        GPIO event logger driver
```

## br2_external/package/gpioevtd/Config.in
```kconfig
config BR2_PACKAGE_GPIOEVTD
    bool "gpioevt daemon"
    help
        GPIO event logger daemon
```
